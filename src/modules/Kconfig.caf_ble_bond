## src/modules/Kconfig.caf_ble_bond
```kconfig
#
# Copyright (c) 2023 mocast
#
# SPDX-License-Identifier: GPL-2.0-only
#

menu "Bluetooth LE Bond"

config CAFKA_BLE_BOND
	bool "Enable the CAF BLE bond module and its dependencies"
	select BT_BONDABLE
	select BT_SETTINGS
	# Settings loader module
	select CAFKA_SETTINGS_LOADER
	select CAF_BLE_COMMON_EVENTS
	select CAF_BLE_BOND
	help
	  Enable the CAF BLE bond module and its dependencies

endmenu
```

## src/modules/Kconfig.caf_ble_state
```kconfig
#
# Copyright (c) 2023 mocast
#
# SPDX-License-Identifier: GPL-2.0-only
#

menu "Bluetooth LE State"

config CAFKA_BLE_STATE
	bool "Enable the CAF BLE state module and its dependencies"
	select BT
	select BT_SMP
	select CAF_BLE_STATE
	help
	  Enable the CAF BLE state module and its dependencies

endmenu
```

## src/modules/Kconfig.caf_buttons
```kconfig
#
# Copyright (c) 2023 mocast
#
# SPDX-License-Identifier: GPL-2.0-only
#

menu "Buttons"

config CAFKA_BUTTONS
	bool "Enable the CAF buttons module and its dependencies"
	select CAF_BUTTONS
	select GPIO
	help
	  Enable the CAF buttons module and its dependencies

endmenu
```

## src/modules/Kconfig.caf_leds
```kconfig
#
# Copyright (c) 2023 mocast
#
# SPDX-License-Identifier: GPL-2.0-only
#

menu "LEDS"

config CAFKA_LEDS
	bool "Enable the CAF LEDS module and its dependencies"
	select PWM
	select LED
	select LED_PWM
	select CAF_LEDS
	help
	  Enable the CAF LEDS module and its dependencies

endmenu
```

## src/modules/Kconfig.caf_power_manager
```kconfig
#
# Copyright (c) 2023 mocast
#
# SPDX-License-Identifier: GPL-2.0-only
#

menu "Power Manager"

config CAFKA_POWER_MANAGER
	bool "Enable the CAF power manager module and its dependencies"
	select CAF_POWER_MANAGER
	select CAF_PM_EVENTS
	help
	  Enable the CAF power manager module and its dependencies

endmenu
```

## src/modules/Kconfig.caf_settings_loader
```kconfig
#
# Copyright (c) 2023 mocast
#
# SPDX-License-Identifier: GPL-2.0-only
#

menu "Settings Loader"

config CAFKA_SETTINGS_LOADER
	bool "Enable the CAF settings loader module and its dependencies"
	select CAF_SETTINGS_LOADER
	select SETTINGS
	select FLASH
	select FLASH_PAGE_LAYOUT
	select FLASH_MAP
	select NVS
	help
	  Enable the CAF power manager module and its dependencies

endmenu
```
