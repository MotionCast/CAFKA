## Kconfig
```kconfig
#
# Copyright (c) 2023 Jacob Sánchez Pérez
#
# SPDX-License-Identifier: BSD-3-Clause
#

menu "CAF Kconfig Assistant"
rsource "modules/Kconfig"
rsource "Kconfig.defaults"
endmenu
```

## Kconfig.defaults
```kconfig
#
# Copyright (c) 2023 Jacob Sánchez Pérez
#
# SPDX-License-Identifier: BSD-3-Clause
#

config CAFKA_COMMON
	bool
	default y
	select APP_EVENT_MANAGER
	select CAF
	help
	  Core requirements for the Common Application Framework

config HEAP_MEM_POOL_SIZE
	default 1024
	help
	  By default, CAF needs the heap size to be set.

config IDLE_STACK_SIZE
	default 1024
	help
	  Prevents an overflow when shutting down some devices.
```

## modules/Kconfig
```kconfig
#
# Copyright (c) 2023 Jacob Sánchez Pérez
#
# SPDX-License-Identifier: BSD-3-Clause
#

menu "CAFKA Modules"

# Power and Settings
rsource "Kconfig.caf_power_manager"
rsource "Kconfig.caf_power_manager.default"
rsource "Kconfig.caf_settings_loader"

# Bluetooth
rsource "Kconfig.ble.default"
rsource "Kconfig.caf_ble_state"
rsource "Kconfig.caf_ble_adv"
rsource "Kconfig.caf_ble_adv.default"
rsource "Kconfig.caf_ble_bond"

# Peripherals
rsource "Kconfig.caf_buttons"
rsource "Kconfig.caf_click_detector"
rsource "Kconfig.caf_sensor_manager"

endmenu
```

## modules/Kconfig.ble.all
```kconfig
#
# Copyright (c) 2023 Jacob Sánchez Pérez
#
# SPDX-License-Identifier: BSD-3-Clause
#

menu "CAFKA BLE all modules"

config CAFKA_BLE_ALL
	bool "Enable all the CAF Bluetooth Low Energy modules"
	select CAFKA_BLE_STATE
	select CAFKA_BLE_ADV
	select CAFKA_BLE_BOND
	help
	  Enable all the CAF BLE modules

endmenu
```

## modules/Kconfig.ble.default
```kconfig
#
# Copyright (c) 2023 Jacob Sánchez Pérez
#
# SPDX-License-Identifier: BSD-3-Clause
#

# Starter configuration overlay for CAF BLE state module.

if CAFKA_BLE_STATE

config BT_PERIPHERAL
	default y
	help
	  By default, device is configured as peripheral.

if BT_PERIPHERAL

config BT_DEVICE_NAME
	default "CAFKA"
	help
	  The default BT peripheral name to advertise under.

config BT_DEVICE_APPEARANCE
	default 1345
	help
	  The default BT peripheral appearance.

config BT_CONN_CTX
	default y
	help
	  Bluetooth context library (helps keep connection presumably)

endif # BT_PERIPHERAL

endif # CAFKA_BLE_STATE
```

## modules/Kconfig.caf_ble_adv
```kconfig
#
# Copyright (c) 2023 Jacob Sánchez Pérez
#
# SPDX-License-Identifier: BSD-3-Clause
#

menu "CAFKA BLE Advertising"

config CAFKA_BLE_ADV
	bool "Enable the CAF BLE advertising module"
	select CAF_BLE_ADV
	select CAF_PM_EVENTS
	# Bluetooth Low Energy state module
	select CAFKA_BLE_STATE
	help
	  Enable the CAF BLE state module

endmenu
```

## modules/Kconfig.caf_ble_adv.default
```kconfig
#
# Copyright (c) 2023 Jacob Sánchez Pérez
#
# SPDX-License-Identifier: BSD-3-Clause
#

# Starter configuration overlay for CAF BLE advertising module.

if CAF_BLE_ADV

config CAF_BLE_ADV_DIRECT_ADV
	default n
	help
	  By default, do not use direct advertising.

config CAF_BLE_ADV_FAST_ADV
	default n
	help
	  By default, do not use fast advertising.

config CAF_BLE_ADV_FILTER_ACCEPT_LIST
	default n
	help
	  By default, disable filter accept list.

config BT_ADV_PROV_FLAGS
	default y
	help
	  By default, add connection flags to advertising providers

config BT_ADV_PROV_DEVICE_NAME
	default y
	help
	  By default, add the device name to advertising providers

config BT_ADV_PROV_GAP_APPEARANCE
	default y
	help
	  By default, add GAP appearance to advertising providers

config BT_ADV_PROV_TX_POWER
	default y
	help
	  By default, add TX power to advertising providers

endif
```

## modules/Kconfig.caf_ble_bond
```kconfig
#
# Copyright (c) 2023 Jacob Sánchez Pérez
#
# SPDX-License-Identifier: BSD-3-Clause
#

menu "CAFKA BLE Bond"

config CAFKA_BLE_BOND
	bool "Enable the CAF Bluetooth Low Energy bond module"
	select BT_BONDABLE
	select BT_SETTINGS
	select CAF_BLE_COMMON_EVENTS
	select CAF_BLE_BOND
	# Settings loader module
	select CAFKA_SETTINGS_LOADER
	help
	  Enable the CAF BLE bond module

endmenu
```

## modules/Kconfig.caf_ble_state
```kconfig
#
# Copyright (c) 2023 Jacob Sánchez Pérez
#
# SPDX-License-Identifier: BSD-3-Clause
#

menu "CAFKA BLE State"

config CAFKA_BLE_STATE
	bool "Enable the CAF Bluetooth Low Energy state module"
	select BT
	select BT_SMP
	select CAF_BLE_STATE
	help
	  Enable the CAF BLE state module

endmenu
```

## modules/Kconfig.caf_buttons
```kconfig
#
# Copyright (c) 2023 Jacob Sánchez Pérez
#
# SPDX-License-Identifier: BSD-3-Clause
#

menu "CAFKA Buttons"

config CAFKA_BUTTONS
	bool "Enable the CAF buttons module"
	select CAF_BUTTONS
	select GPIO
	help
	  Enable the CAF buttons module

endmenu
```

## modules/Kconfig.caf_click_detector
```kconfig
#
# Copyright (c) 2023 Jacob Sánchez Pérez
#
# SPDX-License-Identifier: BSD-3-Clause
#

menu "CAFKA Click Detector"

config CAFKA_CLICK_DETECTOR
	bool "Enable the CAF click detector module"
	select CAF_CLICK_DETECTOR
	select CAF_BUTTON_EVENTS
	select CAF_CLICK_DETECTOR_PM_EVENTS
	help
	  Enable the CAF click detector module

endmenu
```

## modules/Kconfig.caf_leds
```kconfig
#
# Copyright (c) 2023 Jacob Sánchez Pérez
#
# SPDX-License-Identifier: BSD-3-Clause
#

menu "CAFKA LEDs"

config CAFKA_LEDS
	bool "Enable the CAF LEDS module"
	select LED
	select CAF_LEDS

	help
	  Enable the CAF LEDS module


config CAFKA_LEDS_PWM
	bool "Enable the CAF LEDS module"
	select PWM
	select LED_PWM
	select CAF_LEDS_PWM
	# Base requirements
	select CAFKA_LEDS

	help
	  Enable the CAF LEDS PWM module


config CAFKA_LEDS_GPIO
	bool "Enable the CAF LEDS module"
	select GPIO
	select LED_GPIO
	select CAF_LEDS_GPIO
	# Base requirements
	select CAFKA_LEDS

	help
	  Enable the CAF LEDS GPIO module

endmenu
```

## modules/Kconfig.caf_power_manager
```kconfig
#
# Copyright (c) 2023 Jacob Sánchez Pérez
#
# SPDX-License-Identifier: BSD-3-Clause
#

menu "CAFKA Power Manager"

config CAFKA_POWER_MANAGER
	bool "Enable the CAF power manager module"
	select CAF_POWER_MANAGER
	select CAF_PM_EVENTS
	help
	  Enable the CAF power manager module

endmenu
```

## modules/Kconfig.caf_power_manager.default
```kconfig
#
# Copyright (c) 2023 Jacob Sánchez Pérez
#
# SPDX-License-Identifier: BSD-3-Clause
#

# Starter configuration overlay for CAF power manager module.

if CAFKA_POWER_MANAGER

choice PM_POLICY
	default PM_POLICY_CUSTOM
endchoice

config CAF_POWER_MANAGER_TIMEOUT
	default 20
	help
	  The default power timeout

endif
```

## modules/Kconfig.caf_sensor_manager
```kconfig
#
# Copyright (c) 2023 Jacob Sánchez Pérez
#
# SPDX-License-Identifier: BSD-3-Clause
#

menu "CAFKA Sensor Manager"

config CAFKA_SENSOR_MANAGER
	bool "Enable the CAF sensor manager"
	select SENSOR
	select CAF_SENSOR_MANAGER
	help
	  Enable the CAF sensor manager module

endmenu
```

## modules/Kconfig.caf_settings_loader
```kconfig
#
# Copyright (c) 2023 Jacob Sánchez Pérez
#
# SPDX-License-Identifier: BSD-3-Clause
#

menu "CAFKA Settings Loader"

config CAFKA_SETTINGS_LOADER
	bool "Enable the CAF settings loader module"
	select CAF_SETTINGS_LOADER
	select SETTINGS
	select FLASH
	select FLASH_PAGE_LAYOUT
	select FLASH_MAP
	select NVS
	help
	  Enable the CAF power manager module

endmenu
```

## modules/Kconfig.caf_smp
```kconfig
#
# Copyright (c) 2023 Jacob Sánchez Pérez
#
# SPDX-License-Identifier: BSD-3-Clause
#

menu "CAFKA Simple Management Protocol"

config CAFKA_BLE_SMP
	bool "Enable the CAF Simple Management Protocol module"
	select CAF_BLE_SMP
	select MCUMGR_GRP_IMG
	select MCUMGR_MGMT_NOTIFICATION_HOOKS
	select MCUMGR_GRP_IMG_UPLOAD_CHECK_HOOK
	select MCUMGR_TRANSPORT_BT
	select BOOTLOADER_MCUBOOT
	select MCUMGR_GRP_OS
	# Bluetooth State Module
	select CAFKA_BLE_STATE
	help
	  Enable the CAF Simple Management Protocol module

endmenu
```

## src/modules/Kconfig
```kconfig
#
# Copyright (c) 2018 Nordic Semiconductor
#
# SPDX-License-Identifier: LicenseRef-Nordic-5-Clause
#

menu "Application modules"

rsource "Kconfig.ble.default"
rsource "Kconfig.caf_ble_state"
rsource "Kconfig.caf_ble_state.default"
rsource "Kconfig.caf_ble_adv"
rsource "Kconfig.caf_ble_adv.default"
rsource "Kconfig.caf_power_manager"
rsource "Kconfig.caf_power_manager.default"

# Custom modules
rsource "Kconfig.app_state_example" # Barebones listener
rsource "Kconfig.ble_state_example" # Listens to BLE peer events

endmenu
```

## src/modules/Kconfig.app_state_example
```kconfig
#
# Copyright (c) 2023 mocast
#
# SPDX-License-Identifier: GPL-2.0-only
#

menu "App State Example"

config CONFIG_CAFKA_APP_STATE_EXAMPLE
	bool "Enable app state test module"
	depends on CAF
	depends on APP_EVENT_MANAGER
	help
	  Enables a dummy module for testing that reacts to app state events

endmenu
```

## src/modules/Kconfig.app_state_test
```kconfig
#
# Copyright (c) 2018-2021 Nordic Semiconductor ASA
#
# SPDX-License-Identifier: LicenseRef-Nordic-5-Clause
#

menu "App State Test"

config CAFT_APP_STATE_TEST_ENABLE
	bool "Enable app state test module"
	# depends on FEATURE
	# select FEATURE
	help
	  Enables a dummy module for testing that reacts to app state events

endmenu
```

## src/modules/Kconfig.ble.default
```kconfig
#
# Copyright (c) 2023 mocast
#
# SPDX-License-Identifier: GPL-2.0-only
#

# Starter configuration overlay for CAF BLE state module.

if CAFKA_BLE_STATE

config BT_PERIPHERAL
	default y
	help
	  By default, device is configured as peripheral.

if BT_PERIPHERAL

config BT_DEVICE_NAME
	default "CAFKA"
	help
	  The default BT peripheral name to advertise under.

config BT_DEVICE_APPEARANCE
	default 1345
	help
	  The default BT peripheral appearance.

endif # BT_PERIPHERAL

endif # CAFKA_BLE_STATE
```

## src/modules/Kconfig.ble_state_example
```kconfig
#
# Copyright (c) 2023 mocast
#
# SPDX-License-Identifier: GPL-2.0-only
#

menu "BLE State Example"

config CAFKA_BLE_STATE_EXAMPLE
	bool "Enable ble state test module"
	select CAFKA_BLE_ADV
	select CAFKA_BLE_BOND
	select CAFKA_LEDS
	help
	  Enables a dummy module for testing that reacts to BLE state events

endmenu
```

## src/modules/Kconfig.ble_state_test
```kconfig
#
# Copyright (c) 2018-2021 Nordic Semiconductor ASA
#
# SPDX-License-Identifier: LicenseRef-Nordic-5-Clause
#

menu "App State Test"

config CAFT_BLE_STATE_TEST_ENABLE
	bool "Enable app state test module"
	# depends on FEATURE
	# select FEATURE
	select CAFKA_BLE_ADV
	help
	  Enables a dummy module for testing that reacts to app state events

endmenu
```

## src/modules/Kconfig.caf_ble_adv
```kconfig
#
# Copyright (c) 2023 mocast
#
# SPDX-License-Identifier: GPL-2.0-only
#

menu "Bluetooth LE Advertising"

config CAFKA_BLE_ADV
	bool "Enable the CAF BLE advertising module and its dependencies"
	select CAFKA_BLE_STATE
	select CAF_BLE_ADV
	select CAF_PM_EVENTS
	help
	  Enable the CAF BLE state module and its dependencies

endmenu
```

## src/modules/Kconfig.caf_ble_adv.default
```kconfig
#
# Copyright (c) 2023 mocast
#
# SPDX-License-Identifier: GPL-2.0-only
#

# Starter configuration overlay for CAF BLE advertising module.

if CAF_BLE_ADV

config CAF_BLE_ADV_DIRECT_ADV
	default n
	help
	  By default, do not use direct advertising.

config CAF_BLE_ADV_FAST_ADV
	default n
	help
	  By default, do not use fast advertising.

config CAF_BLE_ADV_FILTER_ACCEPT_LIST
	default n
	help
	  By default, enable filter accept list.

config BT_ADV_PROV_FLAGS
	default y
	help
	  By default, add connection flags to advertising providers

config BT_ADV_PROV_DEVICE_NAME
	default y
	help
	  By default, add the device name to advertising providers

config BT_ADV_PROV_GAP_APPEARANCE
	default y
	help
	  By default, add GAP appearance to advertising providers

config BT_ADV_PROV_TX_POWER
	default y
	help
	  By default, add TX power to advertising providers


endif # CAF_BLE_ADV
```
